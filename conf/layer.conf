## conf/layer.conf
```bitbake
# We have a conf and classes directory, add to BBPATH
BBPATH .= ":${LAYERDIR}"

# We have a recipes directory, add to BBFILES
BBFILES += "\
    ${LAYERDIR}/recipes-*/*/*.bb \
    ${LAYERDIR}/recipes-*/*/*.bbappend \
"

BBFILE_COLLECTIONS += "embedded-compositor"
BBFILE_PATTERN_embedded-compositor := "^${LAYERDIR}/"
BBFILE_PRIORITY_embedded-compositor = "7"

LAYERSERIES_COMPAT_embedded-compositor = "langdale mickledore"


# Sanity check for meta-embedded-compositor layer.
INHERIT += "sanity-meta-embedded-compositor"
```
